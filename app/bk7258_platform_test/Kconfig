## app/bk7258_platform_test/Kconfig
```kconfig
config LVX_USE_DEMO_CONTEST2026_272_BK7258_PLATFORM_TEST
  bool "BK7258 platform API test"
  default n
  ---help---
    Enable the manually-invoked BK7258 platform clock, power, IRQ and
    TXEN/RXEN mux readback test.

config LVX_USE_DEMO_CONTEST2026_272_NETSPD
  bool "BK7258 RPMsg frame-path probe (netspd)"
  default n
  ---help---
    Measure the CP/AP RPMsg frame path with netspd echo / netspd send.
    Endpoints use explicit addresses and an empty name, so no NS
    announcement is involved and either side may start first.

config LVX_USE_DEMO_CONTEST2026_272_DRVTEST
  bool "BK7258 native driver probe (bk7258_drvtest)"
  default n
  ---help---
    Shell front end for the nativized driver faces: "bk7258_drvtest uart7"
    exercises the seven UART driver symbols still referenced in the image,
    and "bk7258_drvtest wdt ..." covers the watchdog and reset-reason probe
    that used to live in board/bk7258-devkit/src/bk7258_wdt_test.c.
```

## app/bk7258_wifi_runtime/Kconfig
```kconfig
config BK7258_WIFI_RUNTIME_APP
  bool "BK7258 Wi-Fi runtime manual probe"
  default n
  depends on BK7258_WIFI_VENDOR_RUNTIME
  ---help---
    Add the manually-invoked `bk7258_wifi_runtime init` command.  It never
    starts Wi-Fi automatically; use it only after the base image is running.
```

## board/bk7258-devkit/Kconfig
```kconfig
# BK7258 DevKit board configuration.

config ARCH_BOARD_BK7258_DEVKIT
	bool
	default y

if ARCH_BOARD_BK7258_DEVKIT

config ARCH_BOARD_BK7258_DEVKIT_TAG
	string "Board tag"
	default "bk7258-devkit"

comment "CP/AP/RPMsg SRAM contract is defined by the BK7258 chip configuration"

config ARCH_BOARD_BK7258_DEVKIT_BUTTONS
	bool "Enable board button support"
	depends on BK7258_COMPONENT_AP
	default y
	select ARCH_HAVE_BUTTONS
	select ARCH_HAVE_IRQBUTTONS
	---help---
		Enable the three buttons (KEY1/KEY2/KEY3) on the BK7258 DevKit.
		KEY1=GPIO13, KEY2=GPIO12, KEY3=GPIO8, all active-low with
		internal pull-up.

config BK7258_CONSOLE_AUTO_AP
	bool "Attach the console to the AP NSH at boot"
	depends on BK7258_COMPONENT_CP && SYSTEM_CUTERM && RPMSG_UART
	default y
	---help---
		UART0 stays on the CP.  The CP init task (bk7258_cp_init_main,
		set as INIT_ENTRYPOINT) waits for the AP heartbeat, runs
		"cu -l /dev/ttyAP", and starts the CP NSH when cu exits on "~.".
		Disable to boot straight into the CP NSH as before.

config BK7258_RPTUN_PANIC_PEER
	bool "Panic the other core when this core panics"
	depends on RPTUN && !RPTUN_AUTO_RESET_DISABLE
	default y
	---help---
		On a kernel panic, bk7258_rptun_reset() hands the PANIC reason to
		the NuttX default path, which flags it in the resource table and
		kicks the peer; the peer then panics and prints its own dump
		after this core's.  Disable to leave the peer running.  Set per
		core: each defconfig decides whether its own panic takes the
		other core down.  Normal reboots are unaffected.

config BK7258_PANIC_TEST
	bool "bk7258_panic NSH command (forces a kernel panic)"
	depends on NSH_BUILTIN_APPS
	default y
	---help---
		Development aid to exercise the panic dump path on either core.

config BK7258_CONSOLE_AUTO_AP_TIMEOUT
	int "Seconds to wait for the AP before staying on the CP NSH"
	depends on BK7258_CONSOLE_AUTO_AP
	default 10

config BK7258_MPU_TEST
	bool "MPU/D-cache diagnostic (bk7258_mpu_test NSH command)"
	depends on ARM_MPU
	default n
	---help---
		Adds the bk7258_mpu_test command: dumps and verifies the BK7258
		MPU region table directly from hardware (no fault), runs benign
		Flash/SRAM/PSRAM/peripheral access checks, and offers two fault
		probes (write to P:RO Flash, call into the Device+XN window) that
		prove memory protection on the board.  The probes reset the CPU
		by design; the retained '.noinit' fault record plus the next-boot
		'!FAULT' report are the evidence.

endif # ARCH_BOARD_BK7258_DEVKIT

if LCD_JD9853 || LCD_GC9D01

choice
	prompt "LCD1 display SPI transport"
	default BK7258_LCD1_SPI_BITBANG
	help
		The LCD1 display FPC ("QSPI1" net, GPIO2/3/4/5) can be driven by
		the SoC SPI1 controller or by a GPIO bit-bang lower-half.  The
		bit-bang path is the default: it is the only one verified to boot
		on hardware so far.  The hardware SPI1 master is much faster but
		its register access / pinmux is still under bring-up and will hang
		the board if the SPI1 controller is not reachable from CPU0.

config BK7258_LCD1_SPI_HW
	bool "SoC SPI1 controller"
	select BK7258_SPI
	select SPI_CMDDATA
	---help---
		Drive the LCD1 display FPC through the SPI1 master (GPIO2=SCK,
		GPIO4=MOSI; CS=GPIO3 and D/C=GPIO5 stay plain GPIOs).  This uses
		the ARMINO-derived SPI1 port in src/bk7258_spi_hw.c.

config BK7258_LCD1_SPI_BITBANG
	bool "GPIO bit-bang"
	select SPI_BITBANG
	select SPI_CMDDATA
	---help---
		Fall back to the original GPIO bit-bang lower-half
		(src/bk7258_spi_bitbang.c).  Only selected for bring-up when the
		SPI1 controller path misbehaves.

endchoice

# NOTE: the two lower-halves are compiled against the *choice* symbols
# (BK7258_LCD1_SPI_HW / BK7258_LCD1_SPI_BITBANG) rather than the selected
# infrastructure symbols.  Kconfig choices can leave a stale "select" from
# the previously chosen member in .config; guarding on the choice symbol
# keeps exactly one bk7258_spi_initialize() in the link even in that state.

endif # LCD_JD9853 || LCD_GC9D01

menuconfig LCD_JD9853
	bool "JD9853 SPI LCD panel"
	default n
	select LCD
	select SPI
	---help---
		Enable the JD9853 (Jadard) 4-wire SPI TFT LCD lower-half driver on
		the DevKit display FPC.  The SCL/SDA/D/C/CS lines are driven
		through the SPI transport selected by the "LCD1 display SPI
		transport" choice (hardware SPI1 by default) and the backlight is
		driven by GPIO25.  Register /dev/lcd0 (CONFIG_LCD_DEV) or
		/dev/fb0 (CONFIG_LCD_FRAMEBUFFER) in board_app_initialize() to
		expose the display to applications.

if LCD_JD9853

config LCD_JD9853_SPIMODE
	int "JD9853 SPI mode"
	default 0
	range 0 3
	---help---
		SPI mode used to talk to the JD9853.  The panel requires Mode 0.

config LCD_JD9853_FREQUENCY
	int "JD9853 SPI frequency (Hz)"
	default 6500000
	---help---
		SPI clock frequency requested for the JD9853 display.  The SPI1
		controller derives the actual rate as 26 MHz / (2 * clk_rate), so
		only ~13/6.5/4.33 MHz steps are reachable on the XTAL source.
		6.5 MHz (clk_rate=2) is the conservative default; raise to
		13000000 (clk_rate=1) if the panel accepts the faster clock.

config LCD_JD9853_XRES
	int "JD9853 horizontal resolution"
	default 240
	---help---
		Visible horizontal resolution in pixel columns.

config LCD_JD9853_YRES
	int "JD9853 vertical resolution"
	default 296
	---help---
		Visible vertical resolution in pixel rows.  The JD9853 RAM window is
		240x320; the T201BM-C12-03 2.01 inch panel exposes 240x296.

config LCD_JD9853_XOFFSET
	int "JD9853 horizontal offset"
	default 0
	---help---
		Horizontal offset of the visible area inside the JD9853 RAM window.

config LCD_JD9853_YOFFSET
	int "JD9853 vertical offset"
	default 0
	---help---
		Vertical offset of the visible area inside the JD9853 RAM window.

config LCD_JD9853_BPP
	int "JD9853 bits-per-pixel"
	default 16
	range 16 16
	---help---
		Color depth in bits-per-pixel.  Only 16 (RGB565) is supported.

config LCD_JD9853_BGR
	bool "JD9853 BGR pixel order"
	default n
	---help---
		Set the panel to BGR color order (MADCTL bit 3).

config LCD_JD9853_TE
	bool "JD9853 tearing effect line"
	default n
	---help---
		Enable the tearing effect output line on the JD9853.

config LCD_JD9853_INVERT
	bool "JD9853 inverted display"
	default n
	---help---
		Enable display inversion for panels wired with an inverted
		polarity.

endif # LCD_JD9853

menuconfig LCD_GC9D01
	bool "GC9D01 SPI LCD panel"
	default n
	select LCD
	select SPI
	---help---
		Enable the GC9D01 4-wire SPI TFT LCD lower-half driver for the
		DevKit's two round 0.71" 160x160 panels.  The SCL/SDA/D/C/CS
		lines are driven through the SPI transport selected by the "LCD1
		display SPI transport" choice (hardware SPI1 by default) and the
		backlight is driven by GPIO25.  Register /dev/lcd0
		(CONFIG_LCD_DEV) or /dev/fb0 (CONFIG_LCD_FRAMEBUFFER) in
		board_app_initialize() to expose the display to applications.

if LCD_GC9D01

config LCD_GC9D01_SPIMODE
	int "GC9D01 SPI mode"
	default 0
	range 0 3
	---help---
		SPI mode used to talk to the GC9D01.  The panel requires Mode 0.

config LCD_GC9D01_FREQUENCY
	int "GC9D01 SPI frequency (Hz)"
	default 13000000
	---help---
		SPI clock frequency requested for the GC9D01 display.  The SPI1
		controller derives the actual rate as 26 MHz / (2 * clk_rate), so
		only ~13/6.5/4.33 MHz steps are reachable on the XTAL source.
		13 MHz (clk_rate=1) is the default for the round panels.

config LCD_GC9D01_XRES
	int "GC9D01 horizontal resolution"
	default 160
	---help---
		Visible horizontal resolution in pixel columns.

config LCD_GC9D01_YRES
	int "GC9D01 vertical resolution"
	default 160
	---help---
		Visible vertical resolution in pixel rows.

config LCD_GC9D01_XOFFSET
	int "GC9D01 horizontal offset"
	default 0
	---help---
		Horizontal offset of the visible area inside the RAM window.

config LCD_GC9D01_YOFFSET
	int "GC9D01 vertical offset"
	default 0
	---help---
		Vertical offset of the visible area inside the RAM window.

config LCD_GC9D01_BPP
	int "GC9D01 bits-per-pixel"
	default 16
	range 16 16
	---help---
		Color depth in bits-per-pixel.  Only 16 (RGB565) is supported.

config LCD_GC9D01_BGR
	bool "GC9D01 BGR pixel order"
	default n
	---help---
		Set the panel to BGR color order (MADCTL bit 3).

config LCD_GC9D01_TE
	bool "GC9D01 tearing effect line"
	default n
	---help---
		Enable the tearing effect output line on the GC9D01.

config LCD_GC9D01_INVERT
	bool "GC9D01 inverted display"
	default n
	---help---
		Enable display inversion for panels wired with an inverted
		polarity.

endif # LCD_GC9D01

menu "BK7258 PSRAM layout"

config BK7258_PSRAM_DISPLAY_SIZE
	hex "Display slab (LVGL buffers)"
	default 0x400000
	help
		Fixed slab handed to the AP UI.  Sized for 320x240x16bpp triple
		buffering with headroom; nothing else may claim it.

config BK7258_PSRAM_AUDIO_SIZE
	hex "Audio slab (GDMA capture/playback rings)"
	default 0x80000

config BK7258_PSRAM_ENCODE_SIZE
	hex "Encode slab (JPEG/H264, reserved)"
	default 0x100000

config BK7258_PSRAM_SECTION_SIZE
	hex "PSRAM static-section slab (.psram)"
	default 0x80000
	help
		Holds arrays attributed with __attribute__((section(".psram"))).
		Reserved so the linker section can never collide with a heap.

config BK7258_PSRAM_CP_HEAP_SIZE
	hex "CP PSRAM heap"
	default 0x500000
	help
		The only PSRAM region the CP kernel and the imported Armino code
		may allocate from.  os_check_heap_range() asserts outside it.

config BK7258_PSRAM_AP_HEAP_SIZE
	hex "AP PSRAM heap"
	default 0x500000

endmenu
```
