## chips/bk7258/wifi/Kconfig
```kconfig
#
# chips/bk7258/wifi/Kconfig
#
# BK7258 Wi-Fi skeleton configuration. The MAC/PHY/RF runtime is an external
# vendor input; these symbols select the team-owned NuttX integration only.
# Vendor library path/hash and Beken patch metadata are tracked in
# beken_patch_manifest.md, not here.

menu "BK7258 Wi-Fi"

config BK7258_WIFI
	bool "BK7258 Wi-Fi (NuttX lower-half skeleton)"
	default n
	depends on BK7258_COMPONENT_CP
	depends on NET
	depends on NETDEVICES
	select DRIVERS_WIRELESS
	select NETDEV_WIRELESS_IOCTL
	select NETDEV_WIRELESS_HANDLER
	select DRIVERS_IEEE80211
	select SCHED_HPWORK
	select SCHED_LPWORK
	select ARCH_HAVE_NETDEV_STATISTICS
	help
		Team-owned BK7258 Wi-Fi integration: netdev_lowerhalf +
		wireless_ops_s data/control plane over the Beken MAC/PHY/RF runtime.
		This is a skeleton milestone; it does not link the vendor library
		until a NuttX-buildable vendor library and ABI are available. The
		high-priority worker runs vendor HISR/timer bottom halves; the
		low-priority worker runs the periodic SARADC/PHY temperature task.

if BK7258_WIFI

config BK7258_WIFI_STA
	bool "Wi-Fi station (STA) support"
	default y
	help
		Enable station mode skeleton. SoftAP/P2P/monitor are out of scope
		for the first milestone.

config BK7258_WIFI_AP
	bool "BK7258 Wi-Fi SoftAP support"
	default n
	depends on BK7258_WIFI
	help
		Enable the separate SoftAP provider closure. Keep disabled while the
		STA scan/connect milestone is being brought up.

config BK7258_WIFI_OSAL
	bool "BK7258 Wi-Fi OSAL (NuttX mapping)"
	default y
	help
		Thin wrappers mapping thread/queue/timer/lock/irq/memory onto NuttX
		primitives. Must not create a second scheduler and must not provide
		semantic-empty stubs.

config BK7258_WIFI_VENDOR_PACKET
	bool "BK7258 vendor packet shim"
	default y
	help
		Minimal packet container satisfying the Beken MAC data-path contract
		(next/payload/len/tot_len + private reserve). Distinct from netpkt;
		the lower half converts at the boundary.

config BK7258_WIFI_DEBUG
	bool "BK7258 Wi-Fi skeleton debug logging"
	default n
	depends on DEBUG_FEATURES
	help
		Enable skeleton-stage diagnostics. Must not print passphrase/PMK.

config BK7258_WIFI_VENDOR_LINK
	bool "Link BK7258 vendor Wi-Fi/PHY archives"
	default n
	depends on BK7258_WIFI
	help
		Add the pinned libwifi.a and libbk_phy.a archives to the link.
		This option only brings in the archives; starting the runtime is
		the separate BK7258_WIFI_VENDOR_RUNTIME switch. Do not enable
		this one alone: rw_msg_rx.c is compiled unconditionally and calls
		wpa_clear_scan_results(), which lives in hostapd_intf.c and is
		only compiled under VENDOR_RUNTIME, so LINK=y with RUNTIME=n
		fails to link.

config BK7258_WIFI_VENDOR_RUNTIME
	bool "Start BK7258 vendor Wi-Fi runtime"
	default n
	depends on BK7258_WIFI_VENDOR_LINK
	help
		Compile the vendor runtime and its WPA closure. The BK7258
		board starts it before userspace from a dedicated large-stack
		worker. User-space control is through the standard wapi CLI.

config BK7258_WIFI_WPA_TASK_PRIORITY
	int "WPA task priority"
	default 5
	depends on BK7258_WIFI_VENDOR_RUNTIME
	help
		Armino logical WPA task priority. Its public RTOS API reverses the
		FreeRTOS-native 0..9 priority range, while NuttX uses increasing
		numeric priorities directly. The OSAL therefore reverses this
		logical value while projecting it onto the NuttX scheduler range.

comment "Vendor packet private reserve (beken_genie BK7258 profile)"

config BK7258_WIFI_MSDU_RESV_HEAD_LENGTH
	int "MSDU reserve head length"
	default 108
	depends on BK7258_WIFI_VENDOR_PACKET
	help
		MAC headroom before the Ethernet payload. Locked beken_genie profile
		value; treat as a versioned vendor input, not a silicon constant.

config BK7258_WIFI_MSDU_RESV_DESC_LENGTH
	int "MSDU reserve descriptor length"
	default 600
	depends on BK7258_WIFI_VENDOR_PACKET
	help
		Descriptor private area holding sk_buff + tx descriptor + SG entries.
		The lower half and packet shim must verify that these reserves are
		not exceeded at runtime.

config WPA_PSK_CACHE
	bool "Cache WPA-PSK (PBKDF2) derivations across connects"
	default n
	depends on BK7258_WIFI_VENDOR_RUNTIME
	help
		Derive the PMK once per (SSID, passphrase) in a worker thread and
		reuse it on reconnects, skipping the multi-second PBKDF2 run.  The
		worker self-deletes via rtos_delete_thread(NULL); the NuttX OSAL
		maps that to pthread_exit(), so the vendor's self-delete contract
		is satisfied.  Note: enabling this also activates the vendor's
		2 ms/100-iteration yield inside PBKDF2, which matters only while
		the cache is being filled.

comment "Armino beken_genie config alignment (2026-09-28)"
comment "These CONFIG_* symbols gate #if branches in the Armino glue code"
comment "(rw_task.c, rw_msg_tx.c, rw_msg_rx.c). They must match the values"
comment "compiled into bk_solution_ai/projects/beken_genie. See"
comment "https://feishu.cn/docx/JMj8dZ4lDocze7xxti1cIHjlnjh for the full audit."

config PM_V2
	bool "Armino PM_V2 (core_thread_main PM coupling + lp_clk_accuracy)"
	default y
	depends on BK7258_WIFI
	help
		Gates the PM_V2 variant of core_thread_main in rw_task.c:810
		(calls mac_sleep_check()/ps_msg_process() after every message)
		and the dynamic lp_clk_accuracy branch in rw_msg_tx.c:229.
		Armino beken_genie compiles with this =y.

config PM_ENABLE
	bool "Armino PM_ENABLE"
	default y
	depends on BK7258_WIFI
	help
		Armino power-management enable. Present in beken_genie sdkconfig.h.

config STA_PS
	bool "Armino STA_PS (station power-save message dispatch)"
	default y
	depends on BK7258_WIFI
	help
		Gates BMSG_STA_PS_TYPE handling and ps_flag in core_thread_main.
		Armino beken_genie compiles with this =y.

config WIFI4
	bool "Armino WIFI4 (HT/VHT capability fill in ME_CONFIG_REQ)"
	default y
	depends on BK7258_WIFI
	help
		Gates the HT/VHT capability block in rw_msg_tx.c:261-298.
		Without it ME_CONFIG_REQ carries zeroed HT/VHT caps.
		Armino beken_genie compiles with this =y.

config RWNX_SW_TXQ
	bool "Armino RWNX_SW_TXQ (software TXQ flow control)"
	default y
	depends on BK7258_WIFI
	help
		Gates rwnx_hwq_process_all() calls and TXQ stop/start logic.
		Armino beken_genie compiles with this =y.

config RWNX_TD
	bool "Armino RWNX_TD (TD init)"
	default y
	depends on BK7258_WIFI
	help
		Gates rwnx_td_init() call in rw_ieee80211.c:441.
		Armino beken_genie compiles with this =y.

config SPECIAL_TX_TYPE
	bool "Armino SPECIAL_TX_TYPE (ARP/DHCP special frame dispatch)"
	default y
	depends on BK7258_WIFI
	help
		Gates BMSG_SPECIAL_TX_TYPE handling in rw_task.c.
		Armino beken_genie compiles with this =y.

config WIFI_VNET_CONTROLLER
	bool "Armino WIFI_VNET_CONTROLLER (CIF CP-AP communication)"
	default y
	depends on BK7258_WIFI
	help
		Gates cif_init() and the CIF message path. Armino beken_genie
		compiles with this =y.

config MINIMUM_SCAN_RESULTS
	bool "Armino MINIMUM_SCAN_RESULTS (scan result struct layout)"
	default y
	depends on BK7258_WIFI
	help
		Selects wpa_scan_res* instead of sta_scan_res* in the scan result
		table. Affects sr_malloc_shell layout and sort_scan_result.
		Armino beken_genie compiles with this =y.

config WIFI_SCAN_COUNTRY_CODE
	bool "Armino WIFI_SCAN_COUNTRY_CODE (country-code scan filter)"
	default y
	depends on BK7258_WIFI
	help
		Gates country-code filtering in mhdr_scanu_result_ind.
		Armino beken_genie compiles with this =y.

config WIFI_AUTO_COUNTRY_CODE
	bool "Armino WIFI_AUTO_COUNTRY_CODE (auto country-code policy)"
	default y
	depends on BK7258_WIFI
	help
		Gates ch12/13 active-scan disable and auto policy in scan paths.
		Armino beken_genie compiles with this =y.

config WIFI6
	bool "Armino WIFI6 (HE capability + ARP/MQTT events)"
	default y
	depends on BK7258_WIFI
	help
		Gates HE capability fill and ME_INDICATE_SEND_ARP_IND /
		ME_SEND_MQTT_PINGREQ_IND handling in rw_msg_rx.c.
		Armino beken_genie compiles with this =y.

config PMF
	bool "Armino PMF (management frame protection)"
	default y
	depends on BK7258_WIFI
	help
		Gates RXU_MGT_IND handling in rw_msg_rx.c:1626.
		Armino beken_genie compiles with this =y.

config MAC_SFRAME_SOFTWARE_RETRY
	bool "Armino MAC_SFRAME_SOFTWARE_RETRY (EAPOL/DHCP retry)"
	default y
	depends on BK7258_WIFI
	help
		Gates software retry for EAPOL/DHCP special frames.
		Armino beken_genie compiles with this =y.

config PSRAM_AS_SYS_MEMORY
	bool "Armino PSRAM_AS_SYS_MEMORY (scan results in PSRAM)"
	default y
	depends on BK7258_WIFI
	help
		Gates psram_zalloc vs os_zalloc in sr_malloc_shell.
		Armino beken_genie compiles with this =y.

config CONTROLLER_RX_DIRECT_PSH
	bool "Armino CONTROLLER_RX_DIRECT_PSH (RX direct push)"
	default y
	depends on BK7258_WIFI
	help
		Armino RX direct-push path. Present in beken_genie sdkconfig.h.

config CONTROLLER_WAR
	bool "Armino CONTROLLER_WAR (MAC hardware workaround)"
	default y
	depends on BK7258_WIFI
	help
		Armino MAC hardware workaround. Present in beken_genie sdkconfig.h.

endif # BK7258_WIFI

endmenu
```
